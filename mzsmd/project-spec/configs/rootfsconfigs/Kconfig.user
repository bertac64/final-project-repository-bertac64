## mzsmd/project-spec/configs/rootfsconfigs/Kconfig.user
```kconfig
menu "user packages " 
config epsmdrv  
	 bool "epsmdrv"
	 help
	
config epxcore  
	 bool "epxcore"
	 help
	
config gpio-demo  
	 bool "gpio-demo"
	 help
	
config peekpoke  
	 bool "peekpoke"
	 help
	
endmenu
```
